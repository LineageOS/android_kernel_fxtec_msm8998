## arch/arm64/Kconfig.devices
```kconfig
menu "Device selection"

config DEVICE_IDEALTE
	bool "IdeaLTE device"
	depends on ARM64
	help
	  Support for IdeaLTE devices

config DEVICE_IDEALTE_MSM8998
	bool "IdeaLTE MSM8998 device"
	depends on ARCH_MSM8998
	select DEVICE_IDEALTE
	help
	  Support for MSM8998 IdeaLTE devices

config DEVICE_IDEALTE_COMEIT
	bool "IdeaLTE COMEIT device"
	select DEVICE_IDEALTE_MSM8998

config DEVICE_IDEALTE_CHUS_FQ8
	bool "IdeaLTE CHUS FQ8 device"
	select DEVICE_IDEALTE_MSM8998

config DEVICE_IDEALTE_K1
	bool "IdeaLTE K1 device"
	select DEVICE_IDEALTE_MSM8998

config DEVICE_IDEALTE_T3A
	bool "IdeaLTE T3A device"
	select DEVICE_IDEALTE_MSM8998

config DEVICE_IDEALTE_T5
	bool "IdeaLTE T5 device"
	select DEVICE_IDEALTE_MSM8998

config DEVICE_FXTEC_QX1000
	bool "FxTec QX1000 device"
	select DEVICE_IDEALTE_MSM8998

endmenu
```

## drivers/input/fingerprint/Kconfig
```kconfig
source "drivers/input/fingerprint/betterlife_fp/Kconfig"
source "drivers/input/fingerprint/mas_fp/Kconfig"
source "drivers/input/fingerprint/goodix_fp/Kconfig"
```

## drivers/input/fingerprint/goodix_fp/Kconfig
```kconfig
config GOODIXFP
	bool "Enable Driver Support for fingerprint"
	help
	  Add support for sensors SSC driver.
	  This driver is used for exercising sensors use case,
	  time syncing with ADSP clock.
```

## drivers/input/touchscreen/atmel_mxt/Kconfig
```kconfig
#
# Focaltech Touchscreen driver configuration
#

config TOUCHSCREEN_ATM
        bool "ATM Touchscreen"
		depends on I2C
		default n
		help
		  Say Y here if you have atm touch panel.
		  If unsure, say N.

config TOUCHSCREEN_FTS_DIRECTORY
    string "Atm ts directory name"
    default "atm_touch"
    depends on TOUCHSCREEN_ATM
    
```

## drivers/input/touchscreen/it7259_ts/Kconfig
```kconfig
#
# Focaltech Touchscreen driver configuration
#

config TOUCHSCREEN_IT
        bool "IT Touchscreen"
		depends on I2C
		default n
		help
		  Say Y here if you have it touch panel.
		  If unsure, say N.
```

## drivers/misc/as6313/Kconfig
```kconfig
#
# Makefile for AS6313 driver.
#

config AS6313
	tristate "TYPE-C Support"
	depends on I2C || SPI_MASTER
	help
	This enables support for TYPE-C driver of USB.




 
```
