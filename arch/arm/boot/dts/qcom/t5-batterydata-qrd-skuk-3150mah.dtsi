
qcom,qrd_msm8998_skuk_t5_3150mah {
	qcom, = <24>;
	/* #3842502_Idea_T5FH_3150mAh_averaged_MasterSlave_Feb11th2019*/
	qcom,max-voltage-uv = <4400000>;
	qcom,fg-cc-cv-threshold-mv = <4390>;
	qcom,nom-batt-capacity-mah = <3150>;
	qcom,batt-id-kohm = <101>;
	qcom,battery-beta = <3380>;
	qcom,battery-type = "qrd_msm8998_skuk_t5_3150mah";
	qcom,checksum = <0x7B02>;
	qcom,gui-version = "PMI8998GUI - 2.0.0.58";
	qcom,fg-profile-data = [
		 73 1F C5 05
		 4D 0A 89 06
		 E3 1C BD FB
		 ED 0D 62 0A
		 C0 17 DB 23
		 5D 44 59 5A
		 78 00 00 00
		 10 00 00 00
		 00 00 30 BD
		 64 C4 55 C2
		 1E 00 08 00
		 E2 E2 8C ED
		 0C 06 03 01
		 65 00 D7 12
		 76 F5 D8 32
		 1F 06 09 20
		 27 00 14 00
		 34 20 09 05
		 DD 0A F7 05
		 CE 1C D1 02
		 51 0C ED 0B
		 93 18 8F 23
		 5E 44 92 5A
		 71 00 00 00
		 0F 00 00 00
		 00 00 27 D5
		 C4 C3 A0 CA
		 19 00 00 00
		 79 EB 8C ED
		 86 06 8A F2
		 C3 ED 41 0A
		 25 01 26 22
		 BC 33 CC FF
		 07 10 00 00
		 92 0C 66 46
		 19 00 40 00
		 85 01 0A FA
		 FF 00 00 00
		 00 00 00 00
		 00 00 00 00
		 00 00 00 00
		 00 00 00 00
		 00 00 00 00
		 00 00 00 00
		 00 00 00 00
		 00 00 00 00
		 00 00 00 00
		 00 00 00 00
		 00 00 00 00
		 00 00 00 00
		 00 00 00 00
		 00 00 00 00
		 00 00 00 00
		 00 00 00 00
		 00 00 00 00
		 00 00 00 00
	];
};
