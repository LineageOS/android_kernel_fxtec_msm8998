
qcom,qrd_t3a_3000mah {
	//qcom, = <24>;
	/* #3410317_Idea_T3Atm_3000mAh_averaged_MasterSlave_Apr13th2018*/
	qcom,max-voltage-uv = <4400000>;
	qcom,nom-batt-capacity-mah = <3000>;
	qcom,fastchg-current-ma = <2200>;
	qcom,batt-id-kohm = <50 90>;
	qcom,battery-beta = <3380>;
	qcom,fg-cc-cv-threshold-mv = <4390>;
	qcom,battery-type = "qrd_t3a_3000mah";
	qcom,checksum = <0x5B10>;
	qcom,gui-version = "PMI8998GUI - 2.0.0.58";
	qcom,fg-profile-data = [
		 B2 20 49 04
		 76 0B 64 05
		 E3 1C 53 FB
		 CC 04 BE 03
		 28 17 A2 23
		 18 45 2C 53
		 88 00 00 00
		 13 00 00 00
		 00 00 61 CD
		 16 C4 A6 CB
		 1E 00 08 00
		 A8 DA 9F E5
		 5E 06 99 F3
		 0B F2 01 13
		 9C 06 3E 32
		 1C 06 09 20
		 27 00 14 00
		 F4 20 06 04
		 BE 0B 09 05
		 CB 1C A0 02
		 C2 0C 71 0B
		 6E 18 FF 22
		 87 45 D5 52
		 79 00 00 00
		 12 00 00 00
		 00 00 AB D4
		 3A BB 0E D3
		 1A 00 00 00
		 71 E3 9F E5
		 C2 06 59 F2
		 A4 E5 01 0B
		 0B 07 6A 1A
		 AA 33 CC FF
		 07 10 00 00
		 4B 0C 66 46
		 1A 00 40 00
		 AA 01 0A FA
		 FF 00 00 00
		 00 00 00 00
		 00 00 00 00
		 00 00 00 00
		 00 00 00 00
		 00 00 00 00
		 00 00 00 00
		 00 00 00 00
		 00 00 00 00
		 00 00 00 00
		 00 00 00 00
		 00 00 00 00
		 00 00 00 00
		 00 00 00 00
		 00 00 00 00
		 00 00 00 00
		 00 00 00 00
		 00 00 00 00
		 00 00 00 00
	];
};
