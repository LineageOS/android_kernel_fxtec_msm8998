/* Copyright (c) 2017, The Linux Foundation. All rights reserved.
 *
 * This program is free software; you can redistribute it and/or modify
 * it under the terms of the GNU General Public License version 2 and
 * only version 2 as published by the Free Software Foundation.
 *
 * This program is distributed in the hope that it will be useful,
 * but WITHOUT ANY WARRANTY; without even the implied warranty of
 * MERCHANTABILITY or FITNESS FOR A PARTICULAR PURPOSE.  See the
 * GNU General Public License for more details.
 */

&mdss_mdp {
	dsi_rm67162_e1194aa62a_amoled_fhd_cmd: qcom,mdss_dsi_rm67162_e1194aa62a_amoled_fhd_video{
		qcom,mdss-dsi-panel-name ="rm67162_e1194aa62a amoled fhd cmd mode dsi panel k1 2019-03-29";
		qcom,mdss-dsi-panel-type = "dsi_video_mode";
		qcom,mdss-dsi-panel-framerate = <60>;
		//qcom,mdss-dsi-panel-clockrate = <838600000>;
		qcom,mdss-dsi-virtual-channel-id = <0>;
		qcom,mdss-dsi-stream = <0>;
		qcom,mdss-dsi-panel-controller = <&mdss_dsi1>;
		qcom,mdss-dsi-panel-destination = "display_2";
		qcom,mdss-dsi-panel-width = <390>;
		qcom,mdss-dsi-panel-height = <390>;
		qcom,mdss-dsi-h-front-porch = <20>;
		qcom,mdss-dsi-h-back-porch = <40>;
		qcom,mdss-dsi-h-pulse-width = <20>;
		qcom,mdss-dsi-h-sync-skew = <0>;
		qcom,mdss-dsi-v-back-porch = <12>;
		qcom,mdss-dsi-v-front-porch = <20>;
		qcom,mdss-dsi-v-pulse-width = <4>;
		qcom,mdss-dsi-h-left-border = <0>;
		qcom,mdss-dsi-h-right-border = <0>;
		qcom,mdss-dsi-v-top-border = <0>;
		qcom,mdss-dsi-v-bottom-border = <0>;
		qcom,mdss-dsi-bpp = <24>;
		//qcom,mdss-dsi-color-order = "rgb_swap_rgb";
		qcom,mdss-dsi-underflow-color = <0xff>;
		qcom,mdss-dsi-border-color = <0>;
		qcom,mdss-pan-physical-width-dimension = <32>;
		qcom,mdss-pan-physical-height-dimension = <34>;
		
		qcom,mdss-dsi-on-command = [
				15 01 00 00 00 00 02 fe 05
				15 01 00 00 00 00 02 05 00
				15 01 00 00 00 00 02 fe 00
				15 01 00 00 00 00 02 35 00
				15 01 00 00 00 00 02 36 40
				15 01 00 00 00 00 02 53 20
				39 01 00 00 00 00 05 2a 00 06 01 8b
				39 01 00 00 00 00 05 2b 00 00 01 85
				15 01 00 00 00 00 02 11 00
				15 01 00 00 78 00 02 29 00];
		//qcom,mdss-dsi-on-command = [
		//		15 01 00 00 00 00 02 fe 05
		//		15 01 00 00 00 00 02 05 00
		//		15 01 00 00 00 00 02 fe 0a
		//		15 01 00 00 00 00 02 c6 7f
		//		15 01 00 00 00 00 02 c7 80
		//		15 01 00 00 00 00 02 fe 00
		//		15 01 00 00 00 00 02 35 00
		//		15 01 00 00 00 00 02 36 40
		//		15 01 00 00 00 00 02 53 20
		//		39 01 00 00 00 00 05 2a 00 06 01 8b
		//		39 01 00 00 00 00 05 2b 00 00 01 85
		//		15 01 00 00 00 00 02 11 00
		//		15 01 00 00 78 00 02 29 00];
		qcom,mdss-dsi-off-command = [15 01 00 00 32 00 02 28 00
				 15 01 00 00 78 00 02 10 00];
		qcom,mdss-dsi-on-command-state = "dsi_lp_mode";
		qcom,mdss-dsi-off-command-state = "dsi_hs_mode";
		//qcom,mdss-dsi-traffic-mode = "burst_mode";
		qcom,mdss-dsi-h-sync-pulse = <0>;
		qcom,mdss-dsi-traffic-mode = "non_burst_sync_event";
		qcom,mdss-dsi-lane-map = "lane_map_0";
		qcom,mdss-dsi-bllp-eof-power-mode;
		qcom,mdss-dsi-bllp-power-mode;
		qcom,mdss-dsi-panel-orientation = "180";
		qcom,mdss-dsi-lane-0-state;
		//qcom,mdss-dsi-lane-1-state;
		//qcom,mdss-dsi-lane-2-state;
		//qcom,mdss-dsi-lane-3-state;
		qcom,mdss-dsi-dma-trigger = "trigger_sw";
		qcom,mdss-dsi-mdp-trigger = "none";

		qcom,mdss-dsi-bl-pmic-control-type = "bl_ctrl_dcs";
		qcom,mdss-dsi-bl-dcs-command-state = "dsi_hs_mode";
		qcom,mdss-dsi-bl-min-level = <1>;
		qcom,mdss-dsi-bl-max-level = <255>;

		qcom,mdss-dsi-te-using-te-pin;
		qcom,mdss-dsi-te-pin-select = <1>;
		qcom,mdss-dsi-te-v-sync-rd-ptr-irq-line = <0x2c>;
		qcom,mdss-dsi-te-dcs-command = <1>;

		qcom,mdss-dsi-lp11-init;
		qcom,adjust-timer-wakeup-ms = <1>;
		qcom,mdss-dsi-reset-sequence = <1 20>, <0 20>, <1 120>;
	    //qcom,mdss-dsi-panel-timings = [00 0e 03 03 1e 1d 04 04 02 02 04 00];
	    //qcom,mdss-dsi-t-clk-post = <0x09>;
	    //qcom,mdss-dsi-t-clk-pre = <0x1a>;
		qcom,mdss-dsi-panel-timings = [00 0c 03 03 1d 1d 03 03 01 02 04 00];
	    qcom,mdss-dsi-t-clk-post = <0x09>;
	    qcom,mdss-dsi-t-clk-pre = <0x17>;
        qcom,panel-supply-entries = <&dsi_panel_pwr_hyq_supply>;
	};
};
