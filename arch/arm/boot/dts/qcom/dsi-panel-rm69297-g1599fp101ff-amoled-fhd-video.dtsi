/* Copyright (c) 2017, The Linux Foundation. All rights reserved.
 *
 * This program is free software; you can redistribute it and/or modify
 * it under the terms of the GNU General Public License version 2 and
 * only version 2 as published by the Free Software Foundation.
 *
 * This program is distributed in the hope that it will be useful,
 * but WITHOUT ANY WARRANTY; without even the implied warranty of
 * MERCHANTABILITY or FITNESS FOR A PARTICULAR PURPOSE.  See the
 * GNU General Public License for more details.
 */

&mdss_mdp {
	dsi_rm69297_g1599fp101ff_amoled_fhd_cmd: qcom,mdss_dsi_rm69297_g1599fp101ff_amoled_fhd_video{
		qcom,mdss-dsi-panel-name ="rm69297 g1599fp101ff amoled fhd cmd mode dsi panel t5 2017-08-29";
		qcom,mdss-dsi-panel-type = "dsi_video_mode";
		qcom,mdss-dsi-panel-framerate = <70>;
		//qcom,mdss-dsi-panel-clockrate = <838600000>;
		qcom,mdss-dsi-virtual-channel-id = <0>;
		qcom,mdss-dsi-stream = <0>;
		qcom,mdss-dsi-panel-width = <1080>;
		qcom,mdss-dsi-panel-height = <2160>;
		qcom,mdss-dsi-h-front-porch = <26>;
		qcom,mdss-dsi-h-back-porch = <36>;
		qcom,mdss-dsi-h-pulse-width = <2>;
		qcom,mdss-dsi-h-sync-skew = <0>;
		qcom,mdss-dsi-v-back-porch = <8>;
		qcom,mdss-dsi-v-front-porch = <4>;
		qcom,mdss-dsi-v-pulse-width = <4>;
		qcom,mdss-dsi-h-left-border = <0>;
		qcom,mdss-dsi-h-right-border = <0>;
		qcom,mdss-dsi-v-top-border = <0>;
		qcom,mdss-dsi-v-bottom-border = <0>;
		qcom,mdss-dsi-bpp = <24>;
		//qcom,mdss-dsi-color-order = "rgb_swap_rgb";
		qcom,mdss-dsi-underflow-color = <0xff>;
		qcom,mdss-dsi-border-color = <0>;
		qcom,mdss-pan-physical-width-dimension = <68>;
		qcom,mdss-pan-physical-height-dimension = <136>;
		qcom,mdss-dsi-on-command = [
		39 01 00 00 00 00 02 fe 00
		39 01 00 00 00 00 02 c2 08
		39 01 00 00 00 00 02 35 00
		39 01 00 00 00 00 02 51 ff
		39 01 00 00 00 00 02 11 00
		39 01 00 00 78 00 02 29 00];
		qcom,mdss-dsi-off-command = [05 01 00 00 32 00 02 28 00
				 05 01 00 00 78 00 02 10 00
				 ];
		qcom,mdss-dsi-on-command-state = "dsi_lp_mode";
		qcom,mdss-dsi-off-command-state = "dsi_hs_mode";
		//qcom,mdss-dsi-traffic-mode = "burst_mode";
		qcom,mdss-dsi-h-sync-pulse = <0>;
		qcom,mdss-dsi-traffic-mode = "non_burst_sync_event";
		qcom,mdss-dsi-lane-map = "lane_map_0123";
		qcom,mdss-dsi-bllp-eof-power-mode;
		qcom,mdss-dsi-bllp-power-mode;
		qcom,mdss-dsi-lane-0-state;
		qcom,mdss-dsi-lane-1-state;
		qcom,mdss-dsi-lane-2-state;
		qcom,mdss-dsi-lane-3-state;
		qcom,mdss-dsi-dma-trigger = "trigger_sw";
		qcom,mdss-dsi-mdp-trigger = "none";

		qcom,mdss-dsi-bl-pmic-control-type = "bl_ctrl_dcs";
	  //qcom,mdss-dsi-bl-dcs-command-state = "dsi_hs_mode";
		qcom,mdss-dsi-bl-min-level = <1>;
		qcom,mdss-dsi-bl-max-level = <255>;

		qcom,mdss-dsi-te-using-te-pin;
		qcom,mdss-dsi-te-pin-select = <1>;
		qcom,mdss-dsi-te-v-sync-rd-ptr-irq-line = <0x2c>;
		qcom,mdss-dsi-te-dcs-command = <1>;

		qcom,mdss-dsi-lp11-init;
		qcom,adjust-timer-wakeup-ms = <1>;
		qcom,mdss-dsi-reset-sequence = <1 20>, <0 10>, <1 20>;
	    qcom,mdss-dsi-panel-timings = [00 16 05 05 09 0e 05 05 04 03 04 00];
	    qcom,mdss-dsi-t-clk-post = <0x06>;
	    qcom,mdss-dsi-t-clk-pre = <0x22>;
        qcom,panel-supply-entries = <&dsi_panel_pwr_supply>;
		//qcom,dcs-cmd-by-left;
		//qcom,adjust-timer-wakeup-ms = <1>;

		//qcom,config-select = <&dsi_dual_jdi_a407_cmd_config0>;

		//dsi_dual_jdi_a407_cmd_config0: config0 {
		//	qcom,split-mode = "dualctl-split";
		//};

		//dsi_dual_jdi_a407_cmd_config1: config1 {
		//	qcom,split-mode = "pingpong-split";
		//};
	};
};
