/* Copyright (c) 2014-2015, The Linux Foundation. All rights reserved.
 *
 * This program is free software; you can redistribute it and/or modify
 * it under the terms of the GNU General Public License version 2 and
 * only version 2 as published by the Free Software Foundation.
 *
 * This program is distributed in the hope that it will be useful,
 * but WITHOUT ANY WARRANTY; without even the implied warranty of
 * MERCHANTABILITY or FITNESS FOR A PARTICULAR PURPOSE.  See the
 * GNU General Public License for more details.
 */

/*---------------------------------------------------------------------------
 * This file is autogenerated file using gcdb parser. Please do not edit it.
 * Update input XML file to add a new entry or update variable in this file
 * VERSION = "1.0"
 *---------------------------------------------------------------------------*/
&mdss_mdp {
	dsi_jdi_1080_2160_fhd_cmd: qcom,mdss_dsi_jdi_1080_2160_fhd_video {
		qcom,mdss-dsi-panel-name ="jdi fhd 5.65inch video mode dsi panel";
		qcom,mdss-dsi-panel-type = "dsi_video_mode";
		qcom,mdss-dsi-panel-framerate = <70>;
		qcom,mdss-dsi-panel-controller = <&mdss_dsi0>;
		qcom,mdss-dsi-panel-destination = "display_1";
		qcom,mdss-dsi-virtual-channel-id = <0>;
		qcom,mdss-dsi-stream = <0>;
		qcom,mdss-dsi-panel-width = <1080>;
		qcom,mdss-dsi-panel-height = <2160>;
		qcom,mdss-dsi-h-front-porch = <16>;
		qcom,mdss-dsi-h-back-porch = <16>;
		qcom,mdss-dsi-h-pulse-width = <4>;
		qcom,mdss-dsi-h-sync-skew = <0>;
		qcom,mdss-dsi-v-back-porch = <4>;
		qcom,mdss-dsi-v-front-porch = <108>;
		qcom,mdss-dsi-v-pulse-width = <4>;
		qcom,mdss-dsi-h-left-border = <0>;
		qcom,mdss-dsi-h-right-border = <0>;
		qcom,mdss-dsi-v-top-border = <0>;
		qcom,mdss-dsi-v-bottom-border = <0>;
		qcom,mdss-dsi-bpp = <24>;
		//qcom,mdss-dsi-color-order = "rgb_swap_rgb";
		qcom,mdss-dsi-underflow-color = <0xff>;
		qcom,mdss-dsi-border-color = <0>;
		//qcom,mdss-dsi-panel-operating-mode = <1>;
		qcom,mdss-dsi-on-command = [
			05 01 00 00 C8 00 01 01
			29 01 00 00 00 00 02 00 00
			29 01 00 00 00 00 04 FF 87 19 01
			29 01 00 00 00 00 02 00 80
			29 01 00 00 00 00 03 FF 87 19
			29 01 00 00 00 00 02 00 83
			29 01 00 00 00 00 02 A4 22
			29 01 00 00 00 00 02 00 80
			29 01 00 00 00 00 02 A7 03
			29 01 00 00 00 00 02 00 82
			29 01 00 00 00 00 03 A7 11 01
			29 01 00 00 00 00 02 00 85
			29 01 00 00 00 00 02 A7 00
			29 01 00 00 00 00 02 00 A5
			29 01 00 00 00 00 02 B3 C0
			29 01 00 00 00 00 02 00 A0
			29 01 00 00 00 00 08 C3 31 21 02 10 01 20 12
			29 01 00 00 00 00 02 00 D0
			29 01 00 00 00 00 02 C3 36
			29 01 00 00 00 00 02 00 B3
			29 01 00 00 00 00 02 C5 08
			29 01 00 00 00 00 02 00 80
			29 01 00 00 00 00 11 C2 83 03 20 20 81 00 01 81 82 00 01 81 81 00 01 81
			29 01 00 00 00 00 02 00 90
			29 01 00 00 00 00 11 C2 80 00 01 81 01 00 01 81 02 00 01 81 03 00 01 81
			29 01 00 00 00 00 02 00 A0
			29 01 00 00 00 00 10 C2 82 02 00 25 9E 81 02 00 25 9E 00 02 01 02 82
			29 01 00 00 00 00 02 00 B0
			29 01 00 00 00 00 10 C2 00 02 03 02 82 00 00 00 01 81 00 00 00 01 81
			29 01 00 00 00 00 02 00 C0
			29 01 00 00 00 00 10 C2 00 00 00 01 81 00 00 00 01 81 00 00 00 01 81
			29 01 00 00 00 00 02 00 D0
			29 01 00 00 00 00 10 C2 00 00 00 01 81 00 00 00 01 81 00 00 00 01 81
			29 01 00 00 00 00 02 00 E0
			29 01 00 00 00 00 0F C2 11 37 33 33 33 33 00 0C 12 00 0A 00 01 81
			29 01 00 00 00 00 02 00 F0
			29 01 00 00 00 00 0F C2 00 00 5D 10 00 00 00 55 0A 11 23 3F FF 01
			29 01 00 00 00 00 02 00 80
			29 01 00 00 00 00 11 CB 00 01 00 00 01 00 00 01 00 00 FD 01 00 01 05 03
			29 01 00 00 00 00 02 00 90
			29 01 00 00 00 00 11 CB 00 00 00 00 00 00 00 00 00 00 FF 00 00 00 40 00
			29 01 00 00 00 00 02 00 A0
			29 01 00 00 00 00 05 CB 00 00 00 00
			29 01 00 00 00 00 02 00 B0
			29 01 00 00 00 00 05 CB 55 55 55 57
			29 01 00 00 00 00 02 00 80
			29 01 00 00 00 00 11 CC 00 29 00 23 00 08 00 06 00 07 00 27 00 00 16 17
			29 01 00 00 00 00 02 00 90
			29 01 00 00 00 00 09 CC 18 1C 1D 1E 00 00 00 00
			29 01 00 00 00 00 02 00 80
			29 01 00 00 00 00 11 CD 00 00 02 00 08 00 06 00 07 00 27 00 00 00 16 17
			29 01 00 00 00 00 02 00 90
			29 01 00 00 00 00 09 CD 18 1C 1D 1E 00 00 00 00
			29 01 00 00 00 00 02 00 A0
			29 01 00 00 00 00 11 CC 00 29 00 23 00 08 00 07 00 06 00 27 00 00 16 17
			29 01 00 00 00 00 02 00 B0
			29 01 00 00 00 00 09 CC 18 1C 1D 1E 00 00 00 00
			29 01 00 00 00 00 02 00 A0
			29 01 00 00 00 00 11 CD 00 00 02 00 08 00 07 00 06 00 27 00 00 00 16 17
			29 01 00 00 00 00 02 00 B0
			29 01 00 00 00 00 09 CD 18 1C 1D 1E 00 00 00 00
			29 01 00 00 00 00 02 00 80
			29 01 00 00 00 00 0D C0 00 85 00 6E 00 08 01 03 01 01 18 05
			29 01 00 00 00 00 02 00 D7
			29 01 00 00 00 00 07 C0 00 80 00 6E 00 08
			29 01 00 00 00 00 02 00 90
			29 01 00 00 00 00 07 C0 01 21 00 6E 00 08
			29 01 00 00 00 00 02 00 A0
			29 01 00 00 00 00 07 C0 01 21 00 6E 00 08
			29 01 00 00 00 00 02 00 B0
			29 01 00 00 00 00 06 C0 00 85 01 E2 08
			29 01 00 00 00 00 02 00 C1
			29 01 00 00 00 00 09 C0 00 C0 00 98 00 80 00 E4
			29 01 00 00 00 00 02 00 CA
			29 01 00 00 00 00 02 C0 80
			29 01 00 00 00 00 02 00 A5
			29 01 00 00 00 00 05 C1 00 28 00 02
			29 01 00 00 00 00 02 00 80
			29 01 00 00 00 00 10 CE 01 80 01 09 00 C8 00 C8 00 84 00 84 06 07 04
			29 01 00 00 00 00 02 00 90
			29 01 00 00 00 00 0A CE 00 82 0D 5C 00 7E 82 09 04
			29 01 00 00 00 00 02 00 A0
			29 01 00 00 00 00 04 CE 00 00 00
			29 01 00 00 00 00 02 00 B0
			29 01 00 00 00 00 04 CE 11 00 AD
			29 01 00 00 00 00 02 00 C0
			29 01 00 00 00 00 04 CE 00 00 00
			29 01 00 00 00 00 02 00 D0
			29 01 00 00 00 00 09 CE 91 00 0A 01 01 00 5A 01
			29 01 00 00 00 00 02 00 E0
			29 01 00 00 00 00 0D CE 88 08 02 15 02 15 02 15 00 32 00 5B
			29 01 00 00 00 00 02 00 F0
			29 01 00 00 00 00 0B CE 80 14 0A 0E 01 2C 01 2D 00 E3
			29 01 00 00 00 00 02 00 B0
			29 01 00 00 00 00 05 CF 00 00 64 68
			29 01 00 00 00 00 02 00 B5
			29 01 00 00 00 00 05 CF 04 04 4C 50
			29 01 00 00 00 00 02 00 C0
			29 01 00 00 00 00 05 CF 08 08 20 24
			29 01 00 00 00 00 02 00 C5
			29 01 00 00 00 00 05 CF 00 00 08 0C
			29 01 00 00 00 00 02 00 87
			29 01 00 00 00 00 02 C4 40
			29 01 00 00 00 00 02 00 B3
			29 01 00 00 00 00 07 CE 01 03 01 01 2B 05
			29 01 00 00 00 00 02 00 82
			29 01 00 00 00 00 03 C5 4B 4B
			29 01 00 00 00 00 02 00 00
			29 01 00 00 00 00 03 D8 2B 2B
			29 01 00 00 00 00 02 00 00
			29 01 00 00 00 00 29 E1 00 03 07 0E 34 19 22 29 34 58 3B 41 47 4C A7 51 59 60 67 19 6E 75 7C 84 4B 8E 94 9A A1 49 AA B4 C2 CB 28 D7 E9 F8 FF A3
			29 01 00 00 00 00 02 00 00
			29 01 00 00 00 00 29 E2 00 03 07 0E 34 19 21 28 32 3F 3A 40 45 4A 0A 4F 57 5E 64 03 6B 72 79 81 46 8A 90 96 9D D5 A5 AF BD C6 A9 D2 E5 F6 FF C3
			29 01 00 00 00 00 02 00 00
			29 01 00 00 00 00 29 E3 00 03 07 0E 34 19 22 29 33 01 3A 40 45 4A AF 4F 57 5E 65 68 6B 72 79 81 45 8A 90 95 9C 4F A4 AE BC C4 A3 D0 E2 F4 FF EF
			29 01 00 00 00 00 02 00 00
			29 01 00 00 00 00 29 E4 00 03 07 0E 34 19 22 29 34 58 3B 41 47 4C A7 51 59 60 67 19 6E 75 7C 84 4B 8E 94 9A A1 49 AA B4 C2 CB 28 D7 E9 F8 FF A3
			29 01 00 00 00 00 02 00 00
			29 01 00 00 00 00 29 E5 00 03 07 0E 34 19 21 28 32 3F 3A 40 45 4A 0A 4F 57 5E 64 03 6B 72 79 81 46 8A 90 96 9D D5 A5 AF BD C6 A9 D2 E5 F6 FF C3
			29 01 00 00 00 00 02 00 00
			29 01 00 00 00 00 29 E6 00 03 07 0E 34 19 22 29 33 01 3A 40 45 4A AF 4F 57 5E 65 68 6B 72 79 81 45 8A 90 95 9C 4F A4 AE BC C4 A3 D0 E2 F4 FF EF
			29 01 00 00 00 00 02 00 00
			29 01 00 00 00 00 04 D9 00 9B 9B
			29 01 00 00 00 00 02 00 A3
			29 01 00 00 00 00 02 C5 1B
			29 01 00 00 00 00 02 00 A9
			29 01 00 00 00 00 02 C5 21
			29 01 00 00 00 00 02 00 B0
			29 01 00 00 00 00 03 F3 08 F7
			29 01 00 00 00 00 02 00 E8
			29 01 00 00 00 00 02 C0 40
			29 01 00 00 00 00 02 00 84
			29 01 00 00 00 00 06 C5 3C 3C 00 60 0C
			29 01 00 00 00 00 02 00 85
			29 01 00 00 00 00 02 C4 1E
			29 01 00 00 00 00 02 00 81
			29 01 00 00 00 00 03 F5 5F 5F
			29 01 00 00 00 00 02 00 86
			29 01 00 00 00 00 03 F5 5F 5F
			29 01 00 00 00 00 02 00 89
			29 01 00 00 00 00 02 F5 5F
			29 01 00 00 00 00 02 00 96
			29 01 00 00 00 00 02 F5 5F
			29 01 00 00 00 00 02 00 A6
			29 01 00 00 00 00 02 F5 5F
			29 01 00 00 00 00 02 00 B1
			29 01 00 00 00 00 02 F5 1E
			29 01 00 00 00 00 02 00 AA
			29 01 00 00 00 00 02 F5 8E
			05 01 00 00 78 00 01 11
			05 01 00 00 00 00 01 29
			29 01 00 00 64 00 02 35 00];
		qcom,mdss-dsi-off-command = [05 01 00 00 32 00 02 28 00
				 05 01 00 00 78 00 02 10 00];
		qcom,mdss-dsi-reset-sequence = <1 20>, <0 10>, <1 20>;
		qcom,mdss-dsi-on-command-state = "dsi_lp_mode";
		qcom,mdss-dsi-off-command-state = "dsi_hs_mode";
		qcom,mdss-dsi-h-sync-pulse = <0>;
		qcom,mdss-dsi-traffic-mode = "burst_mode"; // non_burst_sync_event
		qcom,mdss-dsi-lane-map = "lane_map_0123";
		qcom,mdss-dsi-bllp-eof-power-mode;
		qcom,mdss-dsi-bllp-power-mode;
		qcom,mdss-dsi-panel-timings = [00 23 09 09 26 24 09 09 06 02 04 00];
		qcom,mdss-dsi-t-clk-post = <0x0f>;
		qcom,mdss-dsi-t-clk-pre = <0x36>;
		qcom,mdss-dsi-lane-0-state;
		qcom,mdss-dsi-lane-1-state;
		qcom,mdss-dsi-lane-2-state;
		qcom,mdss-dsi-lane-3-state;
		//qcom,mdss-dsi-panel-timings = [00 1f 08 08 24 22 08 08 05 02 04 00];
		//qcom,mdss-dsi-t-clk-post = <0x0d>;
		//qcom,mdss-dsi-t-clk-pre = <0x30>;
		qcom,mdss-dsi-bl-min-level = <1>;
		qcom,mdss-dsi-bl-max-level = <4096>;
		qcom,mdss-dsi-dma-trigger = "trigger_sw";
		qcom,mdss-dsi-mdp-trigger = "none";
		qcom,mdss-dsi-bl-pmic-control-type = "bl_ctrl_wled"; //bl_ctrl_wled
		qcom,panel-supply-entries = <&dsi_panel_pwr_supply>;
		qcom,mdss-pan-physical-width-dimension = <66>;
		qcom,mdss-pan-physical-height-dimension = <134>;
	};
};
